## config/west.yml
```yaml
manifest:
  remotes:
    - name: zmkfirmware
      url-base: https://github.com/zmkfirmware
  projects:
    - name: zmk
      remote: zmkfirmware
      revision: 308de56fb938057da7648a411ce0dce780dfc3f1
      import: app/west.yml
  self:
    path: config
```
